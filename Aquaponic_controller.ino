#include <RTClock.h>
#include <EEPROM.h>

#include <Arduino.h>
#include <U8g2lib.h>

#ifdef U8X8_HAVE_HW_SPI
#include <SPI.h>
#endif
#ifdef U8X8_HAVE_HW_I2C
#include <Wire.h>
#endif

#define Wiring_width 128
#define Wiring_height 48
static unsigned char Wiring_bits[] = {
   0x00, 0x00, 0x00, 0x00, 0x00, 0x00, 0x00, 0x00, 0x00, 0x00, 0x00, 0x00,
   0x00, 0x00, 0x00, 0x00, 0x00, 0x00, 0x00, 0x00, 0x00, 0x00, 0x00, 0x00,
   0x00, 0x00, 0x00, 0x00, 0x00, 0x00, 0x00, 0x00, 0x48, 0x12, 0x02, 0x00,
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   0x00, 0x00, 0x00, 0x00, 0x00, 0x00, 0x00, 0x00, 0x00, 0x00, 0x00, 0x00 };

#define Pinout_Ratings_width 128
#define Pinout_Ratings_height 48
static unsigned char Pinout_Ratings_bits[] = {
   0x00, 0x00, 0x00, 0x00, 0x00, 0x00, 0x00, 0x00, 0x00, 0x00, 0x00, 0x00,
   0x00, 0x00, 0x00, 0x00, 0x00, 0x00, 0x00, 0x00, 0x10, 0x00, 0x00, 0x00,
   0x00, 0x00, 0x00, 0x00, 0x00, 0x00, 0x00, 0x00, 0x82, 0x00, 0x00, 0x00,
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   0x00, 0x00, 0x00, 0x00, 0x00, 0x00, 0x00, 0x00, 0x00, 0x00, 0x00, 0x00 };

#define Pinout_Display_width 128
#define Pinout_Display_height 48
static unsigned char Pinout_Display_bits[] = {
   0x00, 0x00, 0x00, 0x00, 0x00, 0x00, 0x00, 0x00, 0x00, 0x00, 0x00, 0x00,
   0x00, 0x00, 0x00, 0x00, 0x00, 0x00, 0x00, 0x00, 0x00, 0x00, 0x00, 0x00,
   0x00, 0x00, 0x00, 0x00, 0x00, 0x00, 0x00, 0x00, 0x00, 0x00, 0x00, 0x00,
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   0xff, 0xff, 0xff, 0xff, 0xff, 0xff, 0xff, 0x3f, 0x00, 0x00, 0x00, 0x00 };

#define Pinout_width 128
#define Pinout_height 48
static const unsigned char Pinout_bits[] = {
   0x00, 0x00, 0x00, 0x00, 0x00, 0x00, 0x00, 0x00, 0x00, 0x00, 0x00, 0x00,
   0x00, 0x00, 0x00, 0x00, 0x00, 0x00, 0x00, 0x00, 0x00, 0x00, 0x00, 0x00,
   0x00, 0x00, 0x00, 0x00, 0x00, 0x00, 0x00, 0x00, 0x00, 0x00, 0x00, 0x00,
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   0x00, 0x00, 0x00, 0x00, 0x00, 0x00, 0x00, 0x00, 0x00, 0x00, 0x00, 0x00 };


#define DEBUG_ON 0

#define TOPBAR_BOTTOM 15

#define DRAWMODE_TIME(s) u8g2.setFont(u8g2_font_crox3cb_tn); \
                      u8g2.setCursor((u8g2.getDisplayWidth()-u8g2.getStrWidth(s))/2, (u8g2.getDisplayHeight()+u8g2.getMaxCharHeight())/2); //This will always put the time in to the center of the display

#define DRAWMODE_TOPBAR u8g2.setFont(u8g2_font_t0_16b_tf); \
                        u8g2.setCursor(0,10);
                        
#define DRAWMODE_TITLE u8g2.setFont(u8g2_font_t0_16b_tf); \
                        u8g2.setCursor(0,16);

#define DRAWMODE_MENU u8g2.setFont(u8g2_font_t0_16b_tf);
//#define DRAWMODE_MENU u8g2.setFont(u8g2_font_6x12_tr);


#define MENU_X 10
#define MENU_Y TOPBAR_BOTTOM + 1 + u8g2.getMaxCharHeight();


#define SCL PB6
#define SDA PB7

#define BUTTON1 PB4
#define BUTTON2 PB8
#define BUTTON3 PB5

#define RELAY_PIN0 PA8
#define RELAY_PIN1 PA10
#define RELAY_PIN2 PA15
#define RELAY_PIN3 PB3
const uint32_t RELAY_PINS[]={RELAY_PIN0, RELAY_PIN1, RELAY_PIN2, RELAY_PIN3};

#define RELAYS_AMOUNT 4

uint32_t UIstate = 0; //0: time, 1: set time

U8G2_SSD1306_128X64_NONAME_F_SW_I2C u8g2(U8G2_R0, /* clock=*/ SCL, /* data=*/ SDA, /* reset=*/ U8X8_PIN_NONE);   // All Boards without Reset of the Display

String MAIN_MENU[]={"Set time", "Set alarm", "Settings"};
uint32_t MAIN_MENU_SIZE = 3;

String SETTINGS_MENU[]={"Clear memory", "Manual"};
uint32_t SETTINGS_MENU_SIZE = 2;

String MANUAL_MENU[]={"Pinout relays", "Pinout display", "Maximum ratings", "Wiring"};
//uint32_t MANUAL_MENU_SIZE = 4;
#define MANUAL_MENU_SIZE 4
const unsigned char* MANUAL_PICTURES[]={Pinout_bits, Pinout_Display_bits, Pinout_Ratings_bits, Wiring_bits};

uint32_t menuSelection = 0; //which option is selected from the menu

uint32_t debounceTime=0; //to keep time from the last click to rule out debounce interupts

//relay struct
typedef struct{
  int pin;
  int name;
} Relay;


//Timers to turn on and off the relays
typedef struct {
    byte startHour;
    byte startMinute;
    byte endHour;
    byte endMinute;
    String name;
    byte outputRelay;
} Scheduler;


#define SCHEDULERS_AMOUNT 10

Scheduler schedulers[SCHEDULERS_AMOUNT];

//this is where we will store the unix time
uint32_t tt = 0;

//these will store your hours, minutes, seconds for display
//we will update these variables whenever we read the RTC so we can use them over and over wherever we need
byte currentHours = 0;
byte currentMinutes = 0;
byte currentSeconds = 0;

// initialise the RTC library. 
// NOTE: 'RTCSEL_LSE' assumes you have a 32.768Mhz crystal setup physically attached to the appropriate pins 
// on the microcontroller. Pins PC15 and PC14 are the RTC crystal pins.
RTClock rtc (RTCSEL_HSE, 0xf423); // initialise




/*
 * draw the time and blink the hours/minute to indicate time settings
*/
void drawTime(byte hours, byte minutes, byte seconds, bool blinkHours, bool blinkMinutes){ 

  DRAWMODE_TIME("00:00:00")
  
  //print hours
  if(blinkHours && (millis()>>6)%2==1){ //make the number blink
    u8g2.print( "  " );
  }else{ 
    if(hours < 10) { u8g2.print(0); } //leading zeroes to look nice
    u8g2.print( hours );
  }

  //print minutes
  u8g2.print( ":" );
  if(blinkMinutes && (millis()>>6)%2==1){//make the number blink
    u8g2.print( "  " );
  }else{ 
    if(minutes < 10) { u8g2.print(0); } //leading zeroes to look nice
    u8g2.print( minutes );
  }

  //print seconds
  u8g2.print(":");
  if(currentSeconds < 10) { u8g2.print(0); } //leading zeroes to look nice
  u8g2.println( seconds );
  
}


/*
 * draw a menu with given strings and index of selection
 */
void drawMenu(String menuItems[],uint32_t menuSize, uint32_t selectionIndex){

    DRAWMODE_MENU
    uint32_t menuY = MENU_Y;
    
    int menuRows = (u8g2.getDisplayHeight()-16-DEBUG_ON*7)/u8g2.getMaxCharHeight();

      //TODO make draw third element when selectionIndex==0
    for(int i=0; i<=menuSize; i++){ 
      if(selectionIndex<menuRows+i && selectionIndex+menuRows>i){ //only draw as meny you can fit on a screen
        if(i==menuSize && selectionIndex+menuRows>menuSize){ //draw the back option if in the end of the list
          u8g2.setCursor(MENU_X,menuY);
          if(selectionIndex==menuSize) u8g2.print( ">" );
          u8g2.print( "Back" );
        }else{ //draw the menu items
          u8g2.setCursor(MENU_X,menuY);
          if(i==selectionIndex) u8g2.print( ">" );
          u8g2.print( menuItems[i] );
          menuY+=10;
        }
      }
    }
   
    
}


/*
 * extract the schedulers names and draw a menu with them
*/
void drawSchedulerMenu(Scheduler shedulerMenuItems[],uint32_t menuSize, uint32_t selectionIndex){
    String menuItems[menuSize];
    for(int i=0; i<menuSize; i++) menuItems[i]=String(shedulerMenuItems[i].name + " " + String(shedulerMenuItems[i].outputRelay));
    
    drawMenu(menuItems, menuSize, selectionIndex);
}

/*
 * 
 */
void drawRelaySelect(uint32_t selectionIndex){
    String menuItems[4];
    for(int i=0; i<4; i++) menuItems[i]=String("R "+String(i));
    
    drawMenu(menuItems, 4, selectionIndex);
  
}

/*
 * to draw a title explaining the current window
 */
void drawTitle(String title){
  DRAWMODE_TITLE
  u8g2.print(title);
}

/*
 * Draw manual pictures
 */
void drawImage(const unsigned char* image, int width, int height){
  u8g2.drawXBM(0, 16, width, height, image);
}

/*
 * draw debug information in to the bottom of the screen
*/
void drawDebug(){ 
    
    u8g2.setFont(u8g2_font_5x7_tr);
    u8g2.setCursor(0,64);
    u8g2.print( "UIstate: " );
    u8g2.print( UIstate );
    u8g2.print( " menuIndex: " );
    u8g2.print( menuSelection );

}


/*
 * Check if the schedulers are supposed to turn on or off the relays
 */
void checkSchedulers(){
   
    DRAWMODE_TOPBAR
    
    bool relays[RELAYS_AMOUNT];
    for(int i=0;i<RELAYS_AMOUNT;i++) relays[i]=false;
    
    for(int i=0; i<SCHEDULERS_AMOUNT;i++){
      if(currentHours >= schedulers[i].startHour && currentMinutes >= schedulers[i].startMinute && (currentHours < schedulers[i].endHour || (currentHours <= schedulers[i].endHour && currentMinutes < schedulers[i].endMinute))){
        u8g2.print(schedulers[i].name);
        u8g2.print(" ");
        relays[schedulers[i].outputRelay]=true;
      }else{
        for(int j=0;j<schedulers[i].name.length();j++) u8g2.print(" ");
        u8g2.print(" ");
      }
      for(int i=0;i<RELAYS_AMOUNT;i++){
        if(relays[i]==true){
          if(digitalRead(RELAY_PINS[i])!=HIGH) digitalWrite(RELAY_PINS[i], HIGH);
        }
        else{
          if(digitalRead(RELAY_PINS[i])!=LOW) digitalWrite(RELAY_PINS[i], LOW);
        }
      }
    }
}

void saveScheduler(int schedulerN){
  EEPROM.write(schedulerN*5, schedulers[schedulerN].startHour);
  EEPROM.write(schedulerN*5+1, schedulers[schedulerN].startMinute);
  EEPROM.write(schedulerN*5+2, schedulers[schedulerN].endHour);
  EEPROM.write(schedulerN*5+3, schedulers[schedulerN].endMinute);
  EEPROM.write(schedulerN*5+4, schedulers[schedulerN].outputRelay);
}
void readScheduler(int schedulerN){
  schedulers[schedulerN].startHour=EEPROM.read(schedulerN*5);
  schedulers[schedulerN].startMinute=EEPROM.read(schedulerN*5+1);
  schedulers[schedulerN].endHour=EEPROM.read(schedulerN*5+2);
  schedulers[schedulerN].endMinute=EEPROM.read(schedulerN*5+3);
  schedulers[schedulerN].outputRelay=EEPROM.read(schedulerN*5+4);
}

void clearMemory(bool clearCurrent){
  for(int i=0;i<5*SCHEDULERS_AMOUNT;i++){
    EEPROM.write(i, 0);
  }
  if(clearCurrent){
    for(int i=0; i<SCHEDULERS_AMOUNT; i++){
      schedulers[i].startHour=0;
      schedulers[i].startMinute=0;
      schedulers[i].endHour=0;
      schedulers[i].endMinute=0;
      schedulers[i].name=String("T"+String(i));
      schedulers[i].outputRelay=0; 
    }
  }
  
  UIstate=0;
}

/*
 * Main drawing function. Will decide what to draw on the screen based on the given UI state
 */
void draw(int state){
  
  switch(state){
    case 0 : drawTime(currentHours, currentMinutes, currentSeconds, false, false); break;
    case 1 : drawTime(currentHours, currentMinutes, currentSeconds, true, false); break;
    case 2 : drawTime(currentHours, currentMinutes, currentSeconds, false, true); break;
    case 3 : drawMenu(MAIN_MENU, MAIN_MENU_SIZE, menuSelection); break;
    case 4 : drawSchedulerMenu(schedulers, SCHEDULERS_AMOUNT,menuSelection); break;
    case 5 : drawTitle("Erasing..."); break;
    case 6 : drawMenu(SETTINGS_MENU, SETTINGS_MENU_SIZE,menuSelection); break;
    case 7 : drawMenu(MANUAL_MENU, MANUAL_MENU_SIZE, menuSelection); break;
    case 100 ... 100 + SCHEDULERS_AMOUNT: 
              drawTitle("Set start time");
              drawTime(schedulers[UIstate-100].startHour, schedulers[UIstate-100].startMinute, currentSeconds, true, false); break; //TODO actually make show the selected scheduler
    case 200 ... 200 + SCHEDULERS_AMOUNT:
              drawTitle("Set start time");
              drawTime(schedulers[UIstate-200].startHour, schedulers[UIstate-200].startMinute, currentSeconds, false, true); break;
    case 300 ... 300 + SCHEDULERS_AMOUNT:
              drawTitle("Set end time");
              drawTime(schedulers[UIstate-300].endHour, schedulers[UIstate-300].endMinute, currentSeconds, true, false); break; //TODO actually make show the selected scheduler
    case 400 ... 400 + SCHEDULERS_AMOUNT:
              drawTitle("Set end time");
              drawTime(schedulers[UIstate-400].endHour, schedulers[UIstate-400].endMinute, currentSeconds, false, true); break;
    case 500 ... 500 + SCHEDULERS_AMOUNT:
              drawRelaySelect(menuSelection);
              drawTitle("SET RELAYS");
              break;
    case 600 ... 600 + MANUAL_MENU_SIZE:
              drawImage(MANUAL_PICTURES[UIstate-600],128,48);
              break;
  }
}


/*
 * To change a time of a scheduler
 */
void changeSchedulerTime(Scheduler* scheduler, byte startHoursChange, byte startMinutesChange, byte endHoursChange, byte endMinutesChange){
  if(scheduler->startHour-startHoursChange>0)
    scheduler->startHour;  //change hours 
  else scheduler->startHour=23;
}

/* 
 * SELECT BUTTON: will react to the select button press and axt accordingly based on the UI state
 */
void button1Interupt(){
  if(millis()<=debounceTime+200) return; //debounce prevention
  else debounceTime=millis();

  
  switch(UIstate){
    case 0 :  UIstate = 3; //open main menu
              menuSelection=0;
              break;
    case 1 :  UIstate=2; break; //from edit hours to edit minutes
    case 2 :  UIstate=0; break; //end editing minutes
    case 3 :  if(menuSelection==0) UIstate=1; //select change time    //Main menu selection 
              else if(menuSelection==1){ 
                UIstate=4;//select set Schedulers
                menuSelection=0;}
              else if(menuSelection==2){
                UIstate=6;
                menuSelection=0;
              }
              else if(menuSelection==MAIN_MENU_SIZE) UIstate=0;//go back
              break;
    case 4 :  if(menuSelection<SCHEDULERS_AMOUNT) UIstate=100+menuSelection; // scheduler setting menu //select set schedulers 
              else if(menuSelection==SCHEDULERS_AMOUNT){//Back button
                UIstate=3;//go back to main menu
                menuSelection=0; //set the cursor to top of the menu
              }
              break;
    case 6 :  if(menuSelection<SETTINGS_MENU_SIZE){
                if(menuSelection==0){ //clear memory
                  UIstate=5;
                  u8g2.clearBuffer();
                  draw(UIstate);
                  u8g2.sendBuffer();
                  clearMemory(true);
                  UIstate=0;
                }else if(menuSelection==1){
                  UIstate=7; //manual menu
                  menuSelection=0;
                }
              }else if(menuSelection==SETTINGS_MENU_SIZE) UIstate=3;//go back
              break;
    case 7 :  if(menuSelection<MANUAL_MENU_SIZE){ //clear memory
                UIstate=600+menuSelection;
              }
              else if(menuSelection==MANUAL_MENU_SIZE) UIstate=3;//go back
              break; //settings menu
    case 100 ... 100+SCHEDULERS_AMOUNT : //100 - 100+SCHEDULERS_AMOUNT to set the start hours
              UIstate+=100;
              break;
    case 200 ... 200+SCHEDULERS_AMOUNT : //200 - 200+SCHEDULERS_AMOUNT to set the start minutes
              UIstate+=100;
              break;
    case 300 ... 300+SCHEDULERS_AMOUNT : //300 - 300+SCHEDULERS_AMOUNT to set the end hours
              UIstate+=100;
              break;
    case 400 ... 400+SCHEDULERS_AMOUNT : //400 - 400+SCHEDULERS_AMOUNT to set the end minutes
              UIstate+=100;
              menuSelection=0;
              break;
    case 500 ... 500+SCHEDULERS_AMOUNT : //500 - 500+SCHEDULERS_AMOUNT to set the relays
              if(menuSelection<RELAYS_AMOUNT){
                schedulers[UIstate-500].outputRelay = menuSelection;
                saveScheduler(UIstate-500);
              }
              menuSelection=UIstate-500;
              UIstate=4;
              break;
    case 600 ... 600+MANUAL_MENU_SIZE : //600 - 600+MANUAL_MENU_SIZE to show manual images
              UIstate=7;
              break;
  }
  
}

/* 
 * DOWN BUTTON: will react to the down button press and axt accordingly based on the UI state
 */
void button2Interupt(){
  if(millis()<=debounceTime+200) return; //debounce prevention
  else debounceTime=millis();
  
  switch(UIstate){
    case 0 :  /*do nothing*/ break;
    case 1 :  rtc.setTime(rtc.getTime()- 3600);  //change hours 
              break;
    case 2 :  rtc.setTime(rtc.getTime()- 60); //change minutes       
              break;
    case 3 :  menuSelection++; //on the main menu switch the selection
              if(menuSelection>MAIN_MENU_SIZE) menuSelection=0;
              break;
    case 4 :  menuSelection++; //on the scheduler setting menu switch the selection
              if(menuSelection>SCHEDULERS_AMOUNT) menuSelection=0;
              break;
    case 6 :  menuSelection++; //on the main menu switch the selection
              if(menuSelection>SETTINGS_MENU_SIZE) menuSelection=0;
              break;
    case 7 :  menuSelection++; //on the main menu switch the selection
              if(menuSelection>MANUAL_MENU_SIZE) menuSelection=0;
              break;
    case 100 ... 100+SCHEDULERS_AMOUNT : //100 - 100+SCHEDULERS_AMOUNT to set the start hours
              if(schedulers[UIstate-100].startHour>0)
                schedulers[UIstate-100].startHour--;  //change hours 
              else schedulers[UIstate-100].startHour=23;
              break;
    case 200 ... 200+SCHEDULERS_AMOUNT : //200 - 200+SCHEDULERS_AMOUNT to set the start minutes
              if(schedulers[UIstate-200].startMinute>0)
                schedulers[UIstate-200].startMinute--;  //change minutes 
              else schedulers[UIstate-200].startMinute=59;
              break;
    case 300 ... 300+SCHEDULERS_AMOUNT : //300 - 300+SCHEDULERS_AMOUNT to set the end hours
              if(schedulers[UIstate-300].endHour>0)
                schedulers[UIstate-300].endHour--;  //change hours 
              else schedulers[UIstate-300].endHour=23;
              break;
    case 400 ... 400+SCHEDULERS_AMOUNT : //400 - 400+SCHEDULERS_AMOUNT to set the end minutes
              if(schedulers[UIstate-400].endMinute>0)
                schedulers[UIstate-400].endMinute--;  //change minutes
              else schedulers[UIstate-400].endMinute=59;
              break;
    case 500 ... 500+SCHEDULERS_AMOUNT : //500 - 500+SCHEDULERS_AMOUNT to set the relays
              menuSelection++; //on the main menu switch the selection
              if(menuSelection>RELAYS_AMOUNT) menuSelection=0;
              break;//TODO implement increasing the values too
    
  }
}


/* 
 * UP BUTTON: will react to the up button press and axt accordingly based on the UI state
 */
void button3Interupt(){
  if(millis()<=debounceTime+200) return; //debounce prevention
  else debounceTime=millis();

  switch(UIstate){
    case 0 :  /*do nothing*/ break;
    case 1 :  rtc.setTime(rtc.getTime()+ 3600);  //change hours 
              break;
    case 2 :  rtc.setTime(rtc.getTime()+ 60); //change minutes       
              break;
    case 3 :  if(menuSelection>0) menuSelection--;//on the main menu switch the selection
              else menuSelection=MAIN_MENU_SIZE;
              break;
    case 4 :  if(menuSelection>0) menuSelection--;//on the scheduler setting menu switch the selection
              else menuSelection=SCHEDULERS_AMOUNT;
              break;
    case 6 :  if(menuSelection>0) menuSelection--;//on the scheduler setting menu switch the selection
              else menuSelection=SETTINGS_MENU_SIZE;
              break;
     case 7 :  if(menuSelection>0) menuSelection--;//on the scheduler setting menu switch the selection
              else menuSelection=MANUAL_MENU_SIZE;
              break;
    case 100 ... 100+SCHEDULERS_AMOUNT : //100 - 100+SCHEDULERS_AMOUNT to set the start hours
              if(schedulers[UIstate-100].startHour<23)
                schedulers[UIstate-100].startHour++;  //change hours 
              else schedulers[UIstate-100].startHour=0;
              break;
    case 200 ... 200+SCHEDULERS_AMOUNT : //200 - 200+SCHEDULERS_AMOUNT to set the start minutes
              if(schedulers[UIstate-200].startMinute<59)
                schedulers[UIstate-200].startMinute++;  //change minutes 
              else schedulers[UIstate-200].startMinute=0;
              break;
    case 300 ... 300+SCHEDULERS_AMOUNT : //300 - 300+SCHEDULERS_AMOUNT to set the end hours
              if(schedulers[UIstate-300].endHour<23)
                schedulers[UIstate-300].endHour++;  //change hours 
              else schedulers[UIstate-300].endHour=0;
              break;
    case 400 ... 400+SCHEDULERS_AMOUNT : //400 - 400+SCHEDULERS_AMOUNT to set the end minutes
              if(schedulers[UIstate-400].endMinute<59)
                schedulers[UIstate-400].endMinute++;  //change minutes
              else schedulers[UIstate-400].endMinute=00;
              break;
    case 500 ... 500+SCHEDULERS_AMOUNT : //500 - 500+SCHEDULERS_AMOUNT to set the relays
              if(menuSelection>0) menuSelection--;//on the relay menu switch the selection
              else menuSelection=RELAYS_AMOUNT;
              break;
  }  
}



void setup() {
  Serial.begin(9600);
  u8g2.begin();
  //you can also SET the rtc time with rtc.setTime(unixTimestamp) where unixTimestamp is a unix timestamp
  //rtc.setTime(1552258500);

  
  //TODO make read and save to EEPROM for power down recovery
  //initiate EEPROM
      EEPROM.PageBase0 = 0x801F000;
      EEPROM.PageBase1 = 0x801F800;
      EEPROM.PageSize  = 0x400;

  
  //Initiate the timers
  for(int i=0; i<SCHEDULERS_AMOUNT; i++){
    schedulers[i].startHour=0;
    schedulers[i].startMinute=0;
    schedulers[i].endHour=0;
    schedulers[i].endMinute=0;
    schedulers[i].name=String("T"+String(i));
    schedulers[i].outputRelay=0; 
    readScheduler(i);
  }
  //if(EEPROM.read(0)<=23)schedulers[0].startHour=EEPROM.read(0);
  
  

  
  //initiate the OI pins
  pinMode(BUTTON1, INPUT_PULLUP);
  pinMode(BUTTON2, INPUT_PULLUP);
  pinMode(BUTTON3, INPUT_PULLUP);
  
  
  pinMode(RELAY_PIN0, OUTPUT);
  pinMode(RELAY_PIN1, OUTPUT);
  pinMode(RELAY_PIN2, OUTPUT);
  pinMode(RELAY_PIN3, OUTPUT);

  //Initiate the button interrupts
  attachInterrupt(BUTTON1, button1Interupt, FALLING);
  attachInterrupt(BUTTON2, button2Interupt, FALLING);
  attachInterrupt(BUTTON3, button3Interupt, FALLING);

  
  
}

void loop() {


  //Read and break the real time clock time
  tt = rtc.getTime();
  breakTime(tt);
  
   
  u8g2.clearBuffer();
  draw(UIstate);
  checkSchedulers();
  if(DEBUG_ON)drawDebug();
  u8g2.sendBuffer();
  
  delay(200);//or whatever
}

//stolen and simplified from the time library by Paul Stoffregen
//just derives the hours, minutes, seconds from the unix timestamp and sets the global variables we use for display to those values
void breakTime(uint32_t timeInput){
  currentSeconds = timeInput % 60;
  timeInput /= 60; // now it is minutes
  currentMinutes = timeInput % 60;
  timeInput /= 60; // now it is hours
  currentHours = timeInput % 24;
}
